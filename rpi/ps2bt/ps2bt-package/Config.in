## rpi/ps2bt/ps2bt-package/Config.in
```kconfig
config BR2_PACKAGE_PS2BT
	bool "ps2bt"
	help
	  RPi PS2 Bluetooth Adapter device application

comment "RPi PS2 Bluetooth Adapter device application"
```
